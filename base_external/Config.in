## base_external/Config.in
```kconfig
source "../base_external/bme_sensor/Config.in"
source "../base_external/bme_driver/Config.in"
```

## base_external/bme_driver/Config.in
```kconfig
config BR2_PACKAGE_BME_DRIVER
    bool "bme_driver"
    help
      BME Driver, a driver for the BME-280 sensor.
```

## base_external/bme_sensor/Config.in
```kconfig
config BR2_PACKAGE_BME_SENSOR
    bool "bme_sensor"
    help
      A program that reads data from the BME-280 sensor.
        The BME-280 sensor is a temperature, humidity, and pressure sensor.
```
